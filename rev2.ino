/**
 * Arduino interface voor batterij gegevens
 * 
 * Jesse Lammers (c) 2024
*/
// Importeer bibliotheken
#include <SPI.h>
#include <Wire.h>
#include <Adafruit_GFX.h>
#include <Adafruit_SH110X.h>

// INSTELLINGEN en Variablen intitaliseren
#pragma region Instellingen
    // Stel globale instellingen in.
    char projectVersion[] = "2 R.1";
    // Laat waarschuwingen wel / niet zien
    bool displayWarnings = true;



    bool firstBoot = 0;


    // Autoscroll instellingen

    int numberOfUpdates = 50;
    // Tijd in MS voor de volgende check
    int updateDelay = 200;

    // Stel waarden in voor AMP
    const int ampSensorPin = A4;
    const float ampSensorConv_factor = 0.070;
    const float ampSensorConv_offset = -36.10;  // Beetje jammer dat het zo moet, maar ja. Too bad!

    // Stel waarden in voor VOLT
    const int voltSensorPin = A5;
    const float voltSensorConv_factor = 0.024;

    // Voltage grens voor overvolt waarschuwing
    const float chargingWarningThreshold = 14.0;
    
    // Volt RAVG instellingen, ook niet aankomen!

    const byte vMaxvalues = 16;

    const byte aMaxvalues = 16;

    
    // Dynamische waarden
    float sensorConvertedVoltage = 0;
    float sensorConvertedCurrent = 0;

    // Volt RAVG dynamisch
    
    static byte vHuidig = 0;            // Index van huidige waarde
    static byte vHuidigeWaarden = 0;     // Aantal waarden in array
    static float vrSom = 0;              // Rollende som
    static float vValues[vMaxvalues];   

    // Volt RAVG dynamisch
    
    static byte aHuidig = 0;            // Index van huidige waarde
    static byte aHuidigeWaarden = 0;     // Aantal waarden in array
    static float arSom = 0;              // Rollende som
    static float aValues[aMaxvalues];   

    // Stel waarden in voor TEMP
    char tempUnit[] = "C";     // Is nog geen 'const' mochten we dit dynamisch willen aanpassen.
    const float tempSensorConv_factor = 1;

    int tempSensorPin = 8;

    // Stel waarden in voor het OLED scherm
    const int OLED_MOSI = 4;    // SLC
    const int OLED_CLK = 5;     // CLK
    const int OLED_CS = 6;      // SCL
    const int OLED_DC = 7;      // DC
    const int OLED_RST = 12;    // RES(ET)

// NIET AANKOMEN!
int updateid = 0;

// Kan eventueel worden gebruikt indien waarschuwingen clearable zijn.
bool overVoltWarningCleared = 0;

#pragma endregion


// Maak OLED object aan, dit gebruiken we om het scherm mee te bedienen
Adafruit_SH1106G display = Adafruit_SH1106G(128, 64,OLED_MOSI, OLED_CLK, OLED_DC, OLED_RST, OLED_CS);

// 'boot', 128x64px
// 'warning', 128x64px
const unsigned char epd_bitmap_warning [] PROGMEM = {
	0x00, 0x00, 0x00, 0x00, 0x00, 0x00, 0x00, 0x00, 0x00, 0x00, 0x00, 0x00, 0x00, 0x00, 0x00, 0x00, 
	0x00, 0x00, 0x00, 0x00, 0x00, 0x00, 0x00, 0x00, 0x00, 0x00, 0x00, 0x00, 0x00, 0x00, 0x00, 0x00, 
	0x00, 0x00, 0x00, 0x00, 0x00, 0x00, 0x00, 0x00, 0x00, 0x00, 0x00, 0x00, 0x00, 0x00, 0x00, 0x00, 
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	0x00, 0x00, 0x00, 0x00, 0x00, 0x00, 0x00, 0x00, 0x00, 0x00, 0x00, 0x00, 0x00, 0x00, 0x00, 0x00
};
// 'boot', 128x64px
const unsigned char epd_bitmap_boot [] PROGMEM = {
	0x00, 0x00, 0x00, 0x00, 0x00, 0x00, 0x00, 0x00, 0x00, 0x00, 0x00, 0x00, 0x00, 0x00, 0x00, 0x00, 
	0x00, 0x00, 0x00, 0x00, 0x00, 0x00, 0x00, 0x00, 0x00, 0x00, 0x00, 0x00, 0x00, 0x00, 0x00, 0x00, 
	0x00, 0x00, 0x00, 0x00, 0x00, 0x00, 0x00, 0x00, 0x00, 0x00, 0x00, 0x00, 0x00, 0x00, 0x00, 0x00, 
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	0x00, 0x00, 0x00, 0x00, 0x00, 0x00, 0x00, 0x00, 0x00, 0x00, 0x00, 0x00, 0x00, 0x00, 0x00, 0x00
};
// 'opladen', 128x64px
const unsigned char epd_bitmap_opladen [] PROGMEM = {
	0x00, 0x00, 0x00, 0x00, 0x00, 0x00, 0x00, 0x00, 0x00, 0x00, 0x00, 0x00, 0x00, 0x00, 0x00, 0x00, 
	0x00, 0x00, 0x00, 0x00, 0x00, 0x00, 0x00, 0x00, 0x00, 0x00, 0x00, 0x00, 0x00, 0x00, 0x00, 0x00, 
	0x00, 0x00, 0x00, 0x00, 0x00, 0x00, 0x00, 0x00, 0x00, 0x00, 0x00, 0x00, 0x00, 0x00, 0x00, 0x00, 
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	0x00, 0x00, 0x00, 0x00, 0x00, 0x00, 0x00, 0x00, 0x00, 0x00, 0x00, 0x00, 0x00, 0x00, 0x00, 0x00
};

// Array of all bitmaps for convenience. (Total bytes used to store images in PROGMEM = 2080)
const int epd_bitmap_allArray_LEN = 3;
const unsigned char* epd_bitmap_allArray[3] = {
	epd_bitmap_boot,
	epd_bitmap_warning,
    epd_bitmap_opladen
};


// Einde van initialisatie /////////////////////////////////////////////////////////////////////////

void setup(){
/* Opstartcode, initaliseert de seriele verbinding en het scherm.
*/
    Serial.begin(9600);
    display.begin(0, true);
    display.clearDisplay();
    display.drawBitmap(0,0, epd_bitmap_boot, 128, 64, 1);
    display.display();
    return;

    //  Laat de instellingen zien aan de gebruiker als showSettingsOnBoot = True
    // Maak scherm klaar voor tekst
}

void loop(){
    // Reset display
    if(firstBoot == 0){
        delay(4000);
        firstBoot = true;
    }

    // Als autoScroll 'true' is blijf checken tot update_id = numberOfUpdates
    // Ga daarna naar de volgende pagina

    while(updateid <= numberOfUpdates){
        display.display();
        updateDisplay(0);
        Serial.println(updateid);
        updateid++;}

        Serial.println("Exiting");
        batteryStatus();
        updateid = 0;



    // Als autoscroll 'false' is blijf checks uitvoeren.

}

float measureVoltage(){
  // Analoge waarden omzetten in bruikbare waarden voor display
  // DisplayVolts = AnalogeIn * ConversieFactor  
  sensorConvertedVoltage = ((float)analogRead(voltSensorPin)*voltSensorConv_factor);
  
  // Afronding om speling uit sensor te halen, hard cutoff.
  if(sensorConvertedVoltage < 1){
    return(0);
    }
  else{

    // Rolling Average berekenen op basis van x laatste waarden (zie 'const byte maxvalues') 
    // TODO:Kijken of we dit een eigen functie kunnen maken
    vrSom += sensorConvertedVoltage;

    if (vHuidigeWaarden == vMaxvalues){
        vrSom -= vValues[vHuidig];
    }
    
    vValues[vHuidig] = sensorConvertedVoltage;

    if (++vHuidig >= vMaxvalues){
    vHuidig = 0;}

    if (vHuidigeWaarden < vMaxvalues){
    vHuidigeWaarden += 1;}

  return vrSom/vHuidigeWaarden;}    
}

float measureCurrent(){
    // Analoge waarden omzetten in bruikbare waarden voor display
    // DisplayVolts = AnalogeIn * ConversieFactor  
    sensorConvertedCurrent = ((float)analogRead(ampSensorPin))*ampSensorConv_factor + ampSensorConv_offset;

    // Afronding om speling uit sensor te halen, hard cutoff.
    if(sensorConvertedCurrent < 0.15){
        return(0);
        }
    else{

        arSom += sensorConvertedCurrent;

        if (aHuidigeWaarden == aMaxvalues){
            arSom -= aValues[aHuidig];
        }
    
    aValues[aHuidig] = sensorConvertedCurrent;

    if (++aHuidig >= aMaxvalues){
    aHuidig = 0;}

    if (aHuidigeWaarden < aMaxvalues){
    aHuidigeWaarden += 1;}

    return arSom/aHuidigeWaarden;}
}

int updateDisplay(int autoScrollPageID){
            // Als voltage boven oplaadvoltage komt, en displayWarnings staat aan,
            // laat dan de oplaad melding zien

            while(displayWarnings == true && measureVoltage() >= chargingWarningThreshold){
                displayOvervoltWarning();
            }

        // Maak scherm klaar voor tekst
        #pragma region Display Text
            display.clearDisplay();
            display.setTextSize(2);
            display.setTextColor(SH110X_WHITE);
            display.setCursor(0, 0);
            display.println("A >");
            display.setCursor(48, 0);
            display.println(measureCurrent());
            display.setCursor(0, 24);
            display.println("V >");
            display.setCursor(48, 24);
            display.println(measureVoltage());  // Roep volt functie aan
            display.setCursor(0, 48);
            display.println("T >");                                    // TODO, voeg TEMP toe
            display.display();
            delay(updateDelay);
        #pragma endregion

}

int batteryStatus(){
    Serial.println("Battery Function Called");
    if(measureCurrent() == 0){
        // float slope = (100 - 0) / (13.0 - 12.0);
        // float output = 0 + slope * (measureVoltage() - 12.0);
        display.setRotation(2);
        display.clearDisplay();
        display.setTextSize(2);
        display.setTextColor(SH110X_WHITE);
        display.setCursor(0,0);
        display.println("Remaining");
        display.setCursor(0, 16);
        // display.println(output);
        display.display();
        delay(5000);}

    else{
        display.clearDisplay();
        display.setTextSize(2);
        display.setTextColor(SH110X_WHITE);
        display.setCursor(0, 0);
        display.println("CURRENTLY");
        display.setCursor(0, 16);
        display.println("UNDER LOAD");
        display.display();
        delay(5000);}
}


int displayOvervoltWarning(){
    display.clearDisplay();    
    display.drawBitmap(0,0, epd_bitmap_opladen, 128, 64, 1);
    display.display();
    delay(100);
    return 0;
}

int displayHighTempWarning(){
    display.clearDisplay();
    display.drawBitmap(0,0, epd_bitmap_warning, 128, 64, 1);
    display.setTextSize(2);
    display.setCursor(52, 28);
    display.println("Hoge temp.");
    display.display();
    delay(4000);
    return 0;   
}

int displayHighCurrentWarning(){

    display.clearDisplay();
    display.drawBitmap(0,0, epd_bitmap_warning, 128, 64, 1);
    display.setTextSize(2);
    display.setCursor(52, 28);
    display.println("Hoge amp");
    display.display();
    delay(4000);
    return 0;   
}
